## Config.in
```kconfig
source "$BR2_EXTERNAL_TESTDISK_PATH/package/unudhcpd/Config.in"
source "$BR2_EXTERNAL_TESTDISK_PATH/package/usbgadget/Config.in"
```

## configs/testdisk_aarch64_defconfig
```kconfig
BR2_aarch64=y
BR2_TOOLCHAIN_BUILDROOT_MUSL=y
BR2_TOOLCHAIN_BUILDROOT_CXX=y
BR2_OPTIMIZE_S=y
BR2_TARGET_GENERIC_HOSTNAME="testdisk"
BR2_TARGET_GENERIC_ISSUE="Welcome to testdisk"
BR2_ROOTFS_DEVICE_CREATION_DYNAMIC_EUDEV=y
BR2_TARGET_GENERIC_ROOT_PASSWD="testdisk"
# BR2_TARGET_GENERIC_REMOUNT_ROOTFS_RW is not set
BR2_ROOTFS_OVERLAY="$(BR2_EXTERNAL_TESTDISK_PATH)/rootfs_overlay"
BR2_PACKAGE_BUSYBOX_SHOW_OTHERS=y
BR2_PACKAGE_ALSA_UTILS=y
BR2_PACKAGE_ALSA_UTILS_ALSAUCM=y
BR2_PACKAGE_ALSA_UTILS_AMIXER=y
BR2_PACKAGE_ALSA_UTILS_APLAY=y
BR2_PACKAGE_ALSA_UTILS_SPEAKER_TEST=y
BR2_PACKAGE_ATEST=y
BR2_PACKAGE_MPG123=y
BR2_PACKAGE_DHRYSTONE=y
BR2_PACKAGE_FIO=y
BR2_PACKAGE_STRESS_NG=y
BR2_PACKAGE_WHETSTONE=y
BR2_PACKAGE_DRM_INFO=y
BR2_PACKAGE_FBDUMP=y
BR2_PACKAGE_FBGRAB=y
BR2_PACKAGE_FBSET=y
BR2_PACKAGE_WESTON=y
# BR2_PACKAGE_WESTON_SHELL_FULLSCREEN is not set
# BR2_PACKAGE_WESTON_SHELL_IVI is not set
# BR2_PACKAGE_WESTON_SHELL_KIOSK is not set
# BR2_PACKAGE_WESTON_SCREENSHARE is not set
BR2_PACKAGE_I2C_TOOLS=y
BR2_PACKAGE_LM_SENSORS=y
BR2_PACKAGE_MEMTESTER=y
BR2_PACKAGE_RNG_TOOLS=y
BR2_PACKAGE_RTC_TOOLS=y
BR2_PACKAGE_SPI_TOOLS=y
BR2_PACKAGE_LIBDRM_INSTALL_TESTS=y
BR2_PACKAGE_LIBGPIOD2=y
BR2_PACKAGE_LIBGPIOD2_TOOLS=y
BR2_PACKAGE_DROPBEAR=y
# BR2_PACKAGE_DROPBEAR_CLIENT is not set
# BR2_PACKAGE_URANDOM_SCRIPTS is not set
BR2_TARGET_ROOTFS_CPIO=y
BR2_TARGET_ROOTFS_CPIO_XZ=y
# BR2_TARGET_ROOTFS_TAR is not set
BR2_PACKAGE_UNUDHCPD=y
BR2_PACKAGE_USBGADGET=y
```

## package/unudhcpd/Config.in
```kconfig
config BR2_PACKAGE_UNUDHCPD
	bool "unudhcpd"
	help
	  This is an extremely basic DHCP server that only issues 1
	  IP address to any client that sends a DHCP{OFFER,REQUEST}.

	  It is meant to be used on an interface that will only ever
	  see 1 client at a time, but where the client's MAC may change,
	  making it inconvenient to try and configure leasing, etc on other
	  DHCP servers.
	  
	  With unudhcpd, the client always gets an IP quickly.

	  If unsure, say N.
```

## package/usbgadget/Config.in
```kconfig
config BR2_PACKAGE_USBGADGET
	bool "usbgadget"
	help
	  This package provides init scripts for configuring a USB gadget.
	  The default configuration file enables NCM to allow a connected
	  device (like a PC) to directly access on-device network
	  services like an SSH server.

	  If unsure, say N.
```
